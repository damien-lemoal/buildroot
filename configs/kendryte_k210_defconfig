## configs/kendryte_k210_defconfig
```kconfig
# Linux headers same as kernel, a 5.8 series
BR2_PACKAGE_HOST_LINUX_HEADERS_CUSTOM_5_8=y

BR2_riscv=y
# BR2_COMPILER_PARANOID_UNSAFE_PATH is not set
# BR2_UCLIBC_INSTALL_UTILS is not set
BR2_GCC_ENABLE_LTO=y
BR2_PACKAGE_HOST_ELF2FLT=y
# BR2_USE_MMU is not set
BR2_INIT_NONE=y
BR2_ROOTFS_MERGED_USR=y
BR2_SYSTEM_DEFAULT_PATH="/bin:/sbin:/usr/bin:/usr/sbin"
BR2_ROOTFS_OVERLAY="board/kendryte/k210/rootfs_overlay"
BR2_LINUX_KERNEL=y
BR2_LINUX_KERNEL_CUSTOM_VERSION=y
BR2_LINUX_KERNEL_CUSTOM_VERSION_VALUE="5.8"
BR2_LINUX_KERNEL_DEFCONFIG="nommu_k210"
BR2_LINUX_KERNEL_IMAGE_TARGET_CUSTOM=y
BR2_LINUX_KERNEL_IMAGE_NAME="loader.bin"
BR2_LINUX_KERNEL_DTS_SUPPORT=y
BR2_LINUX_KERNEL_DTB_IS_SELF_BUILT=y
BR2_LINUX_KERNEL_INTREE_DTS_NAME="kendryte/k210"
BR2_PACKAGE_BUSYBOX_CONFIG="board/kendryte/k210/busybox-tiny-initramfs.config"
BR2_PACKAGE_BUSYBOX_SHOW_OTHERS=y
# BR2_PACKAGE_IFUPDOWN_SCRIPTS is not set
BR2_TARGET_ROOTFS_INITRAMFS=y
# BR2_TARGET_ROOTFS_TAR is not set
```

## configs/qemu_riscv32_nommu_virt_minimal_defconfig
```kconfig
BR2_riscv=y
BR2_riscv_custom=y
BR2_RISCV_ISA_CUSTOM_RVM=y
BR2_RISCV_32=y
BR2_GLOBAL_PATCH_DIR="board/riscv/nommu/patches"
BR2_PTHREADS_NONE=y
# BR2_USE_MMU is not set
BR2_ROOTFS_POST_IMAGE_SCRIPT="board/qemu/post-image.sh"
BR2_ROOTFS_POST_SCRIPT_ARGS="$(BR2_DEFCONFIG)"
BR2_LINUX_KERNEL=y
BR2_LINUX_KERNEL_CUSTOM_VERSION=y
BR2_LINUX_KERNEL_CUSTOM_VERSION_VALUE="5.18"
BR2_LINUX_KERNEL_DEFCONFIG="nommu_rv32_virt"
BR2_PACKAGE_BUSYBOX_CONFIG="package/busybox/busybox-minimal.config"
# BR2_PACKAGE_IFUPDOWN_SCRIPTS is not set
BR2_TARGET_ROOTFS_EXT2=y
BR2_PACKAGE_HOST_QEMU=y
BR2_PACKAGE_HOST_QEMU_SYSTEM_MODE=y
```

## configs/qemu_riscv64_nommu_virt_defconfig
```kconfig
# Architecture
BR2_riscv=y
BR2_RISCV_64=y

# Toolchain
BR2_PACKAGE_HOST_ELF2FLT=y
# BR2_USE_MMU is not set

# Busybox with hush
BR2_PACKAGE_BUSYBOX_CONFIG="package/busybox/busybox-minimal.config"

# System
BR2_TARGET_GENERIC_GETTY=y

# Filesystem
BR2_TARGET_ROOTFS_EXT2=y

# Image
BR2_ROOTFS_POST_IMAGE_SCRIPT="board/qemu/post-image.sh"
BR2_ROOTFS_POST_SCRIPT_ARGS="$(BR2_DEFCONFIG)"

# Use Linux 5.16 headers until 5.17 headers are available
BR2_PACKAGE_HOST_LINUX_HEADERS_CUSTOM_5_16=y

# Kernel
BR2_LINUX_KERNEL=y
BR2_LINUX_KERNEL_PATCH="board/riscv/nommu/kernel_patches"
BR2_LINUX_KERNEL_CUSTOM_VERSION=y
BR2_LINUX_KERNEL_CUSTOM_VERSION_VALUE="5.17"
BR2_LINUX_KERNEL_DEFCONFIG="nommu_virt"
BR2_LINUX_KERNEL_IMAGE=y

# Disable network scripts
# BR2_PACKAGE_IFUPDOWN_SCRIPTS is not set

# host-qemu for gitlab testing
BR2_PACKAGE_HOST_QEMU=y
BR2_PACKAGE_HOST_QEMU_SYSTEM_MODE=y
```

## configs/rockpro64_ep_defconfig
```kconfig
BR2_aarch64=y
BR2_cortex_a72_a53=y
BR2_BINUTILS_VERSION_2_41_X=y
BR2_GCC_VERSION_13_X=y
BR2_OPTIMIZE_2=y
BR2_TARGET_GENERIC_HOSTNAME="rockpro64-ep"
BR2_TARGET_GENERIC_ISSUE=""
BR2_ROOTFS_DEVICE_CREATION_DYNAMIC_EUDEV=y
BR2_ROOTFS_USERS_TABLES="board/pine64/rockpro64_ep/users.txt"
BR2_ROOTFS_OVERLAY="board/pine64/rockpro64_ep/overlay"
BR2_ROOTFS_POST_BUILD_SCRIPT="board/pine64/rockpro64_ep/post-build.sh"
BR2_ROOTFS_POST_IMAGE_SCRIPT="support/scripts/genimage.sh"
BR2_ROOTFS_POST_SCRIPT_ARGS="-c board/pine64/rockpro64_ep/genimage.cfg"
BR2_LINUX_KERNEL=y
BR2_LINUX_KERNEL_CUSTOM_VERSION=y
BR2_LINUX_KERNEL_CUSTOM_VERSION_VALUE="6.6"
BR2_LINUX_KERNEL_PATCH="board/pine64/rockpro64_ep/linux_patches"
BR2_LINUX_KERNEL_USE_CUSTOM_CONFIG=y
BR2_LINUX_KERNEL_CUSTOM_CONFIG_FILE="board/pine64/rockpro64_ep/linux.config"
BR2_LINUX_KERNEL_DTS_SUPPORT=y
BR2_LINUX_KERNEL_INTREE_DTS_NAME="rockchip/rk3399-rockpro64"
BR2_LINUX_KERNEL_NEEDS_HOST_OPENSSL=y
BR2_PACKAGE_BUSYBOX_CONFIG="board/pine64/rockpro64_ep/busybox.config"
BR2_PACKAGE_BUSYBOX_SHOW_OTHERS=y
BR2_PACKAGE_BUSYBOX_INDIVIDUAL_BINARIES=y
BR2_PACKAGE_FIO=y
BR2_PACKAGE_E2FSPROGS=y
BR2_PACKAGE_LSSCSI=y
BR2_PACKAGE_NVME=y
BR2_PACKAGE_PCIUTILS=y
BR2_PACKAGE_SDPARM=y
BR2_PACKAGE_SG3_UTILS=y
BR2_PACKAGE_SPI_TOOLS=y
BR2_PACKAGE_PYTHON3=y
BR2_PACKAGE_PYTHON_CONFIGSHELL_FB=y
BR2_PACKAGE_PYTHON_NVMETCLI=y
BR2_PACKAGE_OPENSSL=y
BR2_PACKAGE_LIBOPENSSL_BIN=y
BR2_PACKAGE_LIBAIO=y
BR2_PACKAGE_DHCPCD=y
BR2_PACKAGE_DROPBEAR=y
BR2_PACKAGE_DROPBEAR_DISABLE_REVERSEDNS=y
# BR2_PACKAGE_DROPBEAR_SMALL is not set
BR2_PACKAGE_IFUPDOWN=y
BR2_PACKAGE_IPUTILS=y
BR2_PACKAGE_KMOD_TOOLS=y
BR2_PACKAGE_RSYSLOG=y
BR2_PACKAGE_UTIL_LINUX_BINARIES=y
BR2_PACKAGE_UTIL_LINUX_EJECT=y
BR2_PACKAGE_UTIL_LINUX_FSCK=y
BR2_PACKAGE_UTIL_LINUX_IRQTOP=y
BR2_PACKAGE_UTIL_LINUX_KILL=y
BR2_PACKAGE_UTIL_LINUX_LOGIN=y
BR2_PACKAGE_UTIL_LINUX_LOSETUP=y
BR2_PACKAGE_UTIL_LINUX_LSFD=y
BR2_PACKAGE_UTIL_LINUX_MOUNT=y
BR2_PACKAGE_UTIL_LINUX_MOUNTPOINT=y
BR2_PACKAGE_UTIL_LINUX_RENAME=y
BR2_PACKAGE_UTIL_LINUX_SETTERM=y
BR2_PACKAGE_UTIL_LINUX_SU=y
BR2_PACKAGE_UTIL_LINUX_UUIDD=y
BR2_PACKAGE_VIM=y
BR2_TARGET_ROOTFS_EXT2=y
BR2_TARGET_ROOTFS_EXT2_4=y
BR2_TARGET_ROOTFS_EXT2_SIZE="256M"
BR2_TARGET_ARM_TRUSTED_FIRMWARE=y
BR2_TARGET_ARM_TRUSTED_FIRMWARE_CUSTOM_VERSION=y
BR2_TARGET_ARM_TRUSTED_FIRMWARE_CUSTOM_VERSION_VALUE="v2.7"
BR2_TARGET_ARM_TRUSTED_FIRMWARE_PLATFORM="rk3399"
BR2_TARGET_ARM_TRUSTED_FIRMWARE_IMAGES=""
BR2_TARGET_ARM_TRUSTED_FIRMWARE_NEEDS_ARM32_TOOLCHAIN=y
BR2_TARGET_UBOOT=y
BR2_TARGET_UBOOT_BUILD_SYSTEM_KCONFIG=y
BR2_TARGET_UBOOT_CUSTOM_VERSION=y
BR2_TARGET_UBOOT_CUSTOM_VERSION_VALUE="2020.07"
BR2_TARGET_UBOOT_PATCH="board/pine64/rockpro64_ep/uboot_patches"
BR2_TARGET_UBOOT_BOARD_DEFCONFIG="rockpro64-rk3399"
BR2_TARGET_UBOOT_CONFIG_FRAGMENT_FILES="board/pine64/rockpro64_ep/uboot.config"
BR2_TARGET_UBOOT_NEEDS_DTC=y
BR2_TARGET_UBOOT_NEEDS_PYTHON3=y
BR2_TARGET_UBOOT_NEEDS_ATF_BL31=y
BR2_TARGET_UBOOT_NEEDS_ATF_BL31_ELF=y
BR2_TARGET_UBOOT_FORMAT_CUSTOM=y
BR2_TARGET_UBOOT_FORMAT_CUSTOM_NAME="u-boot.itb"
BR2_TARGET_UBOOT_SPL=y
BR2_TARGET_UBOOT_SPL_NAME="idbloader.img"
BR2_PACKAGE_HOST_DOSFSTOOLS=y
BR2_PACKAGE_HOST_GENIMAGE=y
BR2_PACKAGE_HOST_MKPASSWD=y
BR2_PACKAGE_HOST_MTOOLS=y
BR2_PACKAGE_HOST_UBOOT_TOOLS=y
```

## configs/sipeed_maix_bit_defconfig
```kconfig
BR2_riscv=y
# BR2_COMPILER_PARANOID_UNSAFE_PATH is not set
BR2_KERNEL_HEADERS_VERSION=y
BR2_DEFAULT_KERNEL_VERSION="5.13-rc4"
# BR2_UCLIBC_INSTALL_UTILS is not set
BR2_GCC_VERSION_10_X=y
BR2_GCC_ENABLE_LTO=y
BR2_PACKAGE_HOST_ELF2FLT=y
# BR2_USE_MMU is not set
BR2_INIT_NONE=y
BR2_ROOTFS_MERGED_USR=y
BR2_SYSTEM_DEFAULT_PATH="/bin:/sbin:/usr/bin:/usr/sbin"
BR2_ROOTFS_OVERLAY="board/canaan/k210/rootfs_overlay"
BR2_LINUX_KERNEL=y
BR2_LINUX_KERNEL_CUSTOM_VERSION=y
BR2_LINUX_KERNEL_CUSTOM_VERSION_VALUE="5.13-rc4"
BR2_LINUX_KERNEL_DEFCONFIG="nommu_k210"
BR2_LINUX_KERNEL_CONFIG_FRAGMENT_FILES="board/canaan/k210/linux-sipeed-maix-bit-dtb.config"
BR2_LINUX_KERNEL_IMAGE_TARGET_CUSTOM=y
BR2_LINUX_KERNEL_IMAGE_NAME="loader.bin"
BR2_PACKAGE_BUSYBOX_CONFIG="board/canaan/k210/busybox-tiny-initramfs.config"
BR2_PACKAGE_BUSYBOX_SHOW_OTHERS=y
# BR2_PACKAGE_IFUPDOWN_SCRIPTS is not set
BR2_TARGET_ROOTFS_INITRAMFS=y
# BR2_TARGET_ROOTFS_TAR is not set
```

## configs/sipeed_maix_dock_defconfig
```kconfig
BR2_riscv=y
# BR2_COMPILER_PARANOID_UNSAFE_PATH is not set
BR2_KERNEL_HEADERS_5_13=y
# BR2_UCLIBC_INSTALL_UTILS is not set
BR2_GCC_VERSION_11_X=y
BR2_GCC_ENABLE_LTO=y
BR2_PACKAGE_HOST_ELF2FLT=y
# BR2_USE_MMU is not set
BR2_TARGET_GENERIC_HOSTNAME=""
BR2_INIT_NONE=y
BR2_ROOTFS_MERGED_USR=y
BR2_SYSTEM_DEFAULT_PATH="/bin:/sbin:/usr/bin:/usr/sbin"
BR2_ROOTFS_OVERLAY="board/canaan/k210-common/rootfs_overlay"
BR2_LINUX_KERNEL=y
BR2_LINUX_KERNEL_DEFCONFIG="nommu_k210"
BR2_LINUX_KERNEL_CONFIG_FRAGMENT_FILES="board/sipeed/maix-dock/linux-dtb.config"
BR2_LINUX_KERNEL_IMAGE_TARGET_CUSTOM=y
BR2_LINUX_KERNEL_IMAGE_NAME="loader.bin"
BR2_PACKAGE_BUSYBOX_CONFIG="board/canaan/k210-common/busybox-tiny-initramfs.config"
BR2_PACKAGE_BUSYBOX_SHOW_OTHERS=y
# BR2_PACKAGE_IFUPDOWN_SCRIPTS is not set
BR2_TARGET_ROOTFS_INITRAMFS=y
# BR2_TARGET_ROOTFS_TAR is not set
```

## configs/sipeed_maix_go_defconfig
```kconfig
BR2_riscv=y
BR2_PACKAGE_HOST_ELF2FLT=y
# BR2_USE_MMU is not set
BR2_INIT_NONE=y
BR2_ROOTFS_OVERLAY="board/canaan/k210-common/rootfs_overlay"
BR2_LINUX_KERNEL=y
BR2_LINUX_KERNEL_DEFCONFIG="nommu_k210"
BR2_LINUX_KERNEL_CONFIG_FRAGMENT_FILES="board/sipeed/maix-go/linux-dtb.config"
BR2_LINUX_KERNEL_IMAGE_TARGET_CUSTOM=y
BR2_LINUX_KERNEL_IMAGE_NAME="loader.bin"
BR2_PACKAGE_BUSYBOX_CONFIG="package/busybox/busybox-minimal.config"
BR2_PACKAGE_BUSYBOX_CONFIG_FRAGMENT_FILES="board/canaan/k210-common/busybox-tiny.config"
# BR2_PACKAGE_IFUPDOWN_SCRIPTS is not set
BR2_TARGET_ROOTFS_INITRAMFS=y
```

## configs/sipeed_maixduino_sdcard_defconfig
```kconfig
BR2_riscv=y
BR2_PACKAGE_HOST_ELF2FLT=y
# BR2_USE_MMU is not set
BR2_INIT_NONE=y
BR2_ROOTFS_OVERLAY="board/canaan/k210-common/rootfs_overlay"
BR2_LINUX_KERNEL=y
BR2_LINUX_KERNEL_DEFCONFIG="nommu_k210_sdcard"
BR2_LINUX_KERNEL_CONFIG_FRAGMENT_FILES="board/sipeed/maixduino/linux-dtb.config"
BR2_LINUX_KERNEL_IMAGE_TARGET_CUSTOM=y
BR2_LINUX_KERNEL_IMAGE_NAME="loader.bin"
BR2_PACKAGE_BUSYBOX_CONFIG="package/busybox/busybox-minimal.config"
# BR2_PACKAGE_IFUPDOWN_SCRIPTS is not set
BR2_TARGET_ROOTFS_EXT2=y
```

## package/kflash/Config.in.host
```kconfig
config BR2_PACKAGE_HOST_KFLASH
	bool "host kflash"
	depends on BR2_RISCV_64
	select BR2_PACKAGE_HOST_PYTHON_SERIAL
	select BR2_PACKAGE_HOST_PYTHON_PYELFTOOLS
	help
	  Python-based utility tool for flashing image files to boards based on
	  the Canaan Kendryte K210 SoC.

	  https://github.com/sipeed/kflash.py.git
```

## package/python-backportstempfile/Config.in.host
```kconfig
config BR2_PACKAGE_HOST_PYTHON_BACKPORTSTEMPFILE
	bool "host python-backportstempfile"
	select BR2_PACKAGE_HOST_PYTHON_BACKPORTSWEAKREF
	help
	  Backport of new features in Python's tempfile module.

	  https://github.com/pjdelport/backports.tempfile
```

## package/python-backportsweakref/Config.in.host
```kconfig
config BR2_PACKAGE_HOST_PYTHON_BACKPORTSWEAKREF
	bool "host python-backportsweakref"
	select BR2_PACKAGE_HOST_PYTHON_PIP
	help
	  Backport of new features in Python's weakref module.

	  https://github.com/pjdelport/backports.weakref
```

## package/python-kflash/Config.in.host
```kconfig
config BR2_PACKAGE_HOST_PYTHON_KFLASH
	bool "host python-kflash"
	depends on BR2_RISCV_64
	select BR2_PACKAGE_HOST_PYTHON_BACKPORTSTEMPFILE
	select BR2_PACKAGE_HOST_PYTHON_SERIAL
	select BR2_PACKAGE_HOST_PYTHON_PYELFTOOLS
	help
	  Kendryte UART ISP Utility - programming code to k210.

	  https://github.com/vowstar/kflash.py
```

## package/python-nvmetcli/Config.in
```kconfig
config BR2_PACKAGE_PYTHON_NVMETCLI
	bool "python-nvmetcli"
	help
	  An adminstration shell for NVMe storage targets.

	  http://git.infradead.org/users/hch/nvmetcli.git
```

## package/python-pip/Config.in.host
```kconfig
config BR2_PACKAGE_HOST_PYTHON_PIP
	bool "host python-pip"
	select BR2_PACKAGE_PYTHON_SETUPTOOLS # runtime
	select BR2_PACKAGE_HOST_PYTHON3
	select BR2_PACKAGE_HOST_PYTHON3_SSL
	help
	  The PyPA recommended tool for installing Python packages.

	  https://pip.pypa.io/
```

## package/python-pyelftools/Config.in.host
```kconfig
config BR2_PACKAGE_HOST_PYTHON_PYELFTOOLS
	bool "host python-pyelftools"
	help
	  Pyelftools is a Python library for parsing and analyzing ELF
	  files and DWARF debug information.

	  https://github.com/eliben/pyelftools
```

## package/python-serial/Config.in.host
```kconfig
config BR2_PACKAGE_HOST_PYTHON_SERIAL
	bool "host python-serial"
	help
	  python-serial is a Python library to access serial ports.

	  https://github.com/pyserial/pyserial
```
